## block/Kconfig.iosched
```kconfig
if BLOCK

menu "IO Schedulers"

config IOSCHED_NOOP
	bool
	default y
	---help---
	  The no-op I/O scheduler is a minimal scheduler that does basic merging
	  and sorting. Its main uses include non-disk based block devices like
	  memory devices, and specialised software or hardware environments
	  that do their own scheduling and require only minimal assistance from
	  the kernel.

config IOSCHED_SIO
	tristate "Simple I/O (SIO) scheduler"
	default y
	---help---
	  The simple I/O scheduler is based on noop, deadline, and v(r) I/O
	  schedulers.

	  This algorithm does not do any kind of sorting, as it is aimed for
	  aleatory access devices, but it does some basic merging. We try to
	  keep minimum overhead to achieve low latency.

	  Asynchronous and synchronous requests are not treated separately, but
	  we rely on deadlines to ensure fairness.

config IOSCHED_CFQ
	tristate "CFQ I/O scheduler"
	default y
	---help---
	  The CFQ I/O scheduler tries to distribute bandwidth equally
	  among all processes in the system. It should provide a fair
	  and low latency working environment, suitable for both desktop
	  and server systems.

	  This is the default I/O scheduler.

config CFQ_GROUP_IOSCHED
	bool "CFQ Group Scheduling support"
	depends on IOSCHED_CFQ && BLK_CGROUP
	default n
	---help---
	  Enable group IO scheduling in CFQ.

config IOSCHED_BFQ
	tristate "BFQ I/O scheduler"
	default n
	---help---
	  The BFQ I/O scheduler tries to distribute bandwidth among
	  all processes according to their weights.
	  It aims at distributing the bandwidth as desired, independently of
	  the disk parameters and with any workload. It also tries to
	  guarantee low latency to interactive and soft real-time
	  applications. If compiled built-in (saying Y here), BFQ can
	  be configured to support hierarchical scheduling.

config CGROUP_BFQIO
	bool "BFQ hierarchical scheduling support"
	depends on CGROUPS && IOSCHED_BFQ=y
	default n
	---help---
	  Enable hierarchical scheduling in BFQ, using the cgroups
	  filesystem interface.  The name of the subsystem will be
	  bfqio.

choice
	prompt "Default I/O scheduler"
	default DEFAULT_CFQ
	help
	  Select the I/O scheduler which will be used by default for all
	  block devices.

	config DEFAULT_SIO
		bool "SIO" if IOSCHED_SIO=y

	config DEFAULT_CFQ
		bool "CFQ" if IOSCHED_CFQ=y

	config DEFAULT_BFQ
		bool "BFQ" if IOSCHED_BFQ=y
		help
		  Selects BFQ as the default I/O scheduler which will be
		  used by default for all block devices.
		  The BFQ I/O scheduler aims at distributing the bandwidth
		  as desired, independently of the disk parameters and with
		  any workload. It also tries to guarantee low latency to
		  interactive and soft real-time applications.

	config DEFAULT_NOOP
		bool "No-op"

endchoice

config DEFAULT_IOSCHED
	string
	default "sio" if DEFAULT_SIO
	default "cfq" if DEFAULT_CFQ
	default "bfq" if DEFAULT_BFQ
	default "noop" if DEFAULT_NOOP

endmenu

endif
```
