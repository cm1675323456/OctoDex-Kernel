## drivers/cpufreq/Governors/Kconfig
```kconfig
choice
	prompt "Default CPUFreq governor"
	default CPU_FREQ_DEFAULT_GOV_USERSPACE if ARM_SA1100_CPUFREQ || ARM_SA1110_CPUFREQ
	default CPU_FREQ_DEFAULT_GOV_PERFORMANCE
	help
	  This option sets which CPUFreq governor shall be loaded at
	  startup. If in doubt, select 'performance'.

config CPU_FREQ_DEFAULT_GOV_ALUCARD
	bool "alucard"
	select CPU_FREQ_GOV_ALUCARD
	help

config CPU_FREQ_DEFAULT_GOV_DARKNESS
	bool "darkness"
	select CPU_FREQ_GOV_DARKNESS
	help

config CPU_FREQ_DEFAULT_GOV_INTERACTIVEX
	bool "interactiveX"
	select CPU_FREQ_GOV_INTERACTIVEX
	help
	  Use the CPUFreq governor 'interactiveX' as default. This allows
	  you to get a full dynamic cpu frequency capable system by simply
	  loading your cpufreq low-level hardware driver, using the
	  'interactiveX' governor for latency-sensitive workloads.

config CPU_FREQ_DEFAULT_GOV_FRANKENSTEIN
	bool "frankenstein"
	select CPU_FREQ_GOV_frankenstein
	help
	  Use the CPUFreq governor 'frankenstein' as default. This allows
	  you to get a full dynamic cpu frequency capable system by simply
	  loading your cpufreq low-level hardware driver, using the
	  'frankenstein' governor for latency-sensitive workloads.

config CPU_FREQ_DEFAULT_GOV_BARRY_ALLEN
	bool "barry_allen"
	select CPU_FREQ_GOV_BARRY_ALLEN
	help

config CPU_FREQ_DEFAULT_GOV_SMARTMAX
	bool "smartmax"
	select CPU_FREQ_GOV_SMARTMAX
	help
	  Use the CPUFreq governor 'smartmax' as default.

config CPU_FREQ_DEFAULT_GOV_BIOSHOCK
	bool "BioShock"
	select CPU_FREQ_GOV_BIOSHOCK
	help
	  Default governor of BioShock kernel

config CPU_FREQ_DEFAULT_GOV_CONSERVATIVEX
	bool "conservativex"
	select CPU_FREQ_GOV_CONSERVATIVEX
	help
	A less aggressive version of conservative governor

config CPU_FREQ_DEFAULT_GOV_LIONHEART
	bool "lionheart"
	select CPU_FREQ_GOV_LIONHEART
	help
	lionheart' - a "smart" optimized governor!

config CPU_FREQ_DEFAULT_GOV_ADAPTIVE
	bool "adaptive"
	select CPU_FREQ_GOV_ADAPTIVE
	---help---
	'adaptive' - This driver adds a dynamic cpufreq policy governor
	designed for latency-sensitive workloads and also for demanding
	performance.

config CPU_FREQ_DEFAULT_GOV_WHEATLEY
	bool "wheatley"
	select CPU_FREQ_GOV_WHEATLEY
	select CPU_FREQ_GOV_PERFORMANCE
	---help---
	  Use the CPUFreq governor 'wheatley' as default.

config CPU_FREQ_DEFAULT_GOV_PERFORMANCE
	bool "performance"
	select CPU_FREQ_GOV_PERFORMANCE
	help
	  Use the CPUFreq governor 'performance' as default. This sets
	  the frequency statically to the highest frequency supported by
	  the CPU.

config CPU_FREQ_DEFAULT_GOV_POWERSAVE
	bool "powersave"
	depends on EXPERT
	select CPU_FREQ_GOV_POWERSAVE
	help
	  Use the CPUFreq governor 'powersave' as default. This sets
	  the frequency statically to the lowest frequency supported by
	  the CPU.

config CPU_FREQ_DEFAULT_GOV_SMARTASS2
  	bool "smartassV2"
  	select CPU_FREQ_GOV_SMARTASS2
  	help

config CPU_FREQ_DEFAULT_GOV_USERSPACE
	bool "userspace"
	select CPU_FREQ_GOV_USERSPACE
	help
	  Use the CPUFreq governor 'userspace' as default. This allows
	  you to set the CPU frequency manually or when a userspace 
	  program shall be able to set the CPU dynamically without having
	  to enable the userspace governor manually.

config CPU_FREQ_DEFAULT_GOV_ONDEMAND
	bool "ondemand"
	select CPU_FREQ_GOV_ONDEMAND
	select CPU_FREQ_GOV_PERFORMANCE
	help
	  Use the CPUFreq governor 'ondemand' as default. This allows
	  you to get a full dynamic frequency capable system by simply
	  loading your cpufreq low-level hardware driver.
	  Be aware that not all cpufreq drivers support the ondemand
	  governor. If unsure have a look at the help section of the
	  driver. Fallback governor will be the performance governor.

config CPU_FREQ_DEFAULT_GOV_INTERACTIVE
	bool "interactive"
	select CPU_FREQ_GOV_INTERACTIVE
	help
	  Use the CPUFreq governor 'interactive' as default. This allows
	  you to get a full dynamic cpu frequency capable system by simply
	  loading your cpufreq low-level hardware driver, using the
	  'interactive' governor for latency-sensitive workloads.

config CPU_FREQ_DEFAULT_GOV_IMPULSE
	bool "impulse"
	select CPU_FREQ_GOV_IMPULSE
	help
	  Use the CPUFreq governor 'impulse' as default. This allows
	  you to get a full dynamic cpu frequency capable system by simply
	  loading your cpufreq low-level hardware driver, using the
	  'impulse' governor for latency-sensitive workloads.

config CPU_FREQ_DEFAULT_GOV_CYAN
	bool "cyan"
	select CPU_FREQ_GOV_CYAN
	help
	cyan' - an interactive based optimized governor!

config CPU_FREQ_DEFAULT_GOV_BLUACTIVE
	bool "bluactive"
	select CPU_FREQ_GOV_BLUACTIVE
	help
	Use the CPUFreq governor 'bluactive' as default.

config CPU_FREQ_DEFAULT_GOV_INTEL
	bool "intel"
	select CPU_FREQ_GOV_INTEL
	help
	  Use the CPUFreq governor 'intel' as default. This allows
	  you to get a full dynamic cpu frequency capable system by simply
	  loading your cpufreq low-level hardware driver, using the
	  'intel' governor for better perfromance and power with Intel
	  mobile platforms.

config CPU_FREQ_DEFAULT_GOV_SMARTASSH3
  	bool "smartassH3"
  	select CPU_FREQ_GOV_SMARTASSH3
  	help

endchoice

config CPU_FREQ_GOV_BIOSHOCK
	tristate "'bioshock' cpufreq bioshock"
	depends on CPU_FREQ
	help
	  'bioshock' - More aggressive version of conservative

config CPU_FREQ_GOV_INTERACTIVEX
	tristate "'interactiveX' cpufreq policy governor"
	help
	  'interactiveX' - Modified version of interactive with sleep+wake code.

config CPU_FREQ_GOV_FRANKENSTEIN
	tristate "'frankenstein' cpufreq policy governor"
	help
	  'frankenstein' - Modified version of interactive with sleep+wake code.

config CPU_FREQ_GOV_SMARTMAX
	tristate "'smartmax' cpufreq governor"
	depends on CPU_FREQ
	help
	  'smartmax' -  based on "ondemand" and "smartassv2" optimized governor!

	   If in doubt, say N.

config CPU_FREQ_GOV_THESSJACTIVE
	tristate "'thessjactive' cpufreq policy governor"
	depends on CPU_FREQ	
	help
	credits to TheSSJ

config CPU_FREQ_GOV_YANKACTIVE
	tristate "'yankactive' cpufreq policy governor"
	help
	'yankactive' - This driver adds a dynamic cpufreq policy governor
	designed for latency-sensitive workloads.
	The governor is based on interactive with just different default settings
	and can be achieved using interactive with a script. This is added for
	simplification purposes for myself.

config CPU_FREQ_DEFAULT_GOV_HOTPLUG
	bool "hotplug"
	select CPU_FREQ_GOV_HOTPLUG
	select CPU_FREQ_GOV_PERFORMANCE
	help
	  Use the CPUFreq governor 'hotplug' as default. This allows
	  you to get a full dynamic frequency capable system by simply
	  loading your cpufreq low-level hardware driver.
	  Be aware that not all cpufreq drivers support the hotplug
	  governor. If unsure have a look at the help section of the
	  driver. Fallback governor will be the performance governor.

config CPU_FREQ_DEFAULT_GOV_HYBRID
	bool "hybrid"
	select CPU_FREQ_GOV_HYBRID
	select CPU_FREQ_GOV_PERFORMANCE
	help
	  Use the CPUFreq governor 'hybrid' as default. This allows
	  you to get a full dynamic frequency capable system by simply
	  loading your cpufreq low-level hardware driver.
	  Be aware that not all cpufreq drivers support the hybrid
	  governor. If unsure have a look at the help section of the
	  driver. Fallback governor will be the performance governor.

config CPU_FREQ_GOV_CONSERVATIVEX
	tristate "'conservativeX' cpufreq policy governor"
	depends on CPU_FREQ	
	default y	
	help
	A less aggressive version of conservative governor

config CPU_FREQ_GOV_BARRY_ALLEN
	tristate "'barry_allen' cpufreq policy governor"
	help

 +config CPU_FREQ_GOV_INTELLIACTIVE
	tristate "'intelliactive' cpufreq policy governor"
	depends on CPU_FREQ
	default y

config CPU_FREQ_DEFAULT_GOV_LAGFREE
        bool "lagfree"
        select CPU_FREQ_GOV_LAGFREE
        select CPU_FREQ_GOV_PERFORMANCE
        help
          Use the CPUFreq governor 'lagfree' as default. This allows
          you to get a full dynamic frequency capable system by simply
          loading your cpufreq low-level hardware driver.
          Be aware that not all cpufreq drivers support the lagfree
          governor. If unsure have a look at the help section of the
          driver. Fallback governor will be the performance governor.

config CPU_FREQ_DEFAULT_GOV_HYBRID
	bool "hybrid"
	select CPU_FREQ_GOV_HYBRID
	select CPU_FREQ_GOV_PERFORMANCE
	help
	  Use the CPUFreq governor 'hybrid' as default. This allows
	  you to get a full dynamic frequency capable system by simply
	  loading your cpufreq low-level hardware driver.
	  Be aware that not all cpufreq drivers support the hybrid
	  governor. If unsure have a look at the help section of the
	  driver. Fallback governor will be the performance governor.


config CPU_FREQ_GOV_LIONHEART
	tristate "'lionheart' cpufreq governor"
	depends on CPU_FREQ
	default y
	help
	lionheart' - a "smart" optimized governor!

config CPU_FREQ_GOV_ADAPTIVE
	tristate "'adaptive' cpufreq policy governor"
	---help---
	  'adaptive' - This driver adds a dynamic cpufreq policy governor
	  designed for latency-sensitive workloads and also for demanding
	  performance.

config CPU_FREQ_GOV_SMARTASS2
  	tristate "'smartassV2' cpufreq governor"
  	depends on CPU_FREQ
  	help
    	'smartassV2' - a "smart" governor

config CPU_FREQ_GOV_WHEATLEY
	   tristate "'wheatley' cpufreq governor"
	   depends on CPU_FREQ

config CPU_FREQ_GOV_ALUCARD
	tristate "'alucard' cpufreq governor"
	depends on CPU_FREQ

config CPU_FREQ_GOV_DARKNESS
	tristate "'darkness' cpufreq governor"	
	depends on CPU_FREQ

config CPU_FREQ_GOV_PERFORMANCE
	tristate "'performance' governor"
	help
	  This cpufreq governor sets the frequency statically to the
	  highest available CPU frequency.

	  To compile this driver as a module, choose M here: the
	  module will be called cpufreq_performance.

	  If in doubt, say Y.

config CPU_FREQ_GOV_DYNAMIC_INTERACTIVE
	tristate "'dynamic_interactive' cpufreq governor"
	depends on CPU_FREQ

config CPU_FREQ_GOV_POWERSAVE
	tristate "'powersave' governor"
	help
	  This cpufreq governor sets the frequency statically to the
	  lowest available CPU frequency.

	  To compile this driver as a module, choose M here: the
	  module will be called cpufreq_powersave.

	  If in doubt, say Y.

config CPU_FREQ_GOV_USERSPACE
	tristate "'userspace' governor for userspace frequency scaling"
	help
	  Enable this cpufreq governor when you either want to set the
	  CPU frequency manually or when a userspace program shall
	  be able to set the CPU dynamically, like on LART 
	  <http://www.lartmaker.nl/>.

	  To compile this driver as a module, choose M here: the
	  module will be called cpufreq_userspace.

	  For details, take a look at <file:Documentation/cpu-freq/>.

	  If in doubt, say Y.

config CPU_FREQ_GOV_ONDEMAND
	tristate "'ondemand' cpufreq policy governor"
	select CPU_FREQ_TABLE
	select CPU_FREQ_GOV_COMMON
	help
	  'ondemand' - This driver adds a dynamic cpufreq policy governor.
	  The governor does a periodic polling and 
	  changes frequency based on the CPU utilization.
	  The support for this governor depends on CPU capability to
	  do fast frequency switching (i.e, very low latency frequency
	  transitions). 

	  To compile this driver as a module, choose M here: the
	  module will be called cpufreq_ondemand.

	  For details, take a look at linux/Documentation/cpu-freq.

	  If in doubt, say N.

config CPU_FREQ_GOV_INTERACTIVE
	tristate "'interactive' cpufreq policy governor"
	help
	  'interactive' - This driver adds a dynamic cpufreq policy governor
	  designed for latency-sensitive workloads.

	  This governor attempts to reduce the latency of clock
	  increases so that the system is more responsive to
	  interactive workloads.

	  To compile this driver as a module, choose M here: the
	  module will be called cpufreq_interactive.

	  For details, take a look at linux/Documentation/cpu-freq.

	  If in doubt, say N.

config CPU_FREQ_GOV_CYAN
	tristate "'cyan' cpufreq governor"
	depends on CPU_FREQ
	default y
	help
	cyan' - an interactive based optimized governor!

config CPU_FREQ_GOV_LAGFREE
        tristate "'lagfree' cpufreq governor"
        depends on CPU_FREQ
        help
          'lagfree' - this driver is rather similar to the 'ondemand'
          governor both in its source code and its purpose, the difference is
          its optimisation for better suitability in a battery powered
          environment.  The frequency is gracefully increased and decreased
          rather than jumping to 100% when speed is required.

          To compile this driver as a module, choose M here: the
          module will be called cpufreq_lagfree.

          For details, take a look at linux/Documentation/cpu-freq.

          If in doubt, say N.

config CPU_FREQ_GOV_IMPULSE
	tristate "'impulse' cpufreq policy governor"
	help
	  'impulse' - This driver adds a dynamic cpufreq policy governor
	  designed for latency-sensitive workloads.

	  If in doubt, say N.

config CPU_FREQ_GOV_LULZACTIVE
	tristate "'lulzactive' cpufreq governor"
	depends on CPU_FREQ
	help
	  'lulzactive' - a new interactive governor by Tegrak!
	  For more information please visit:
	  http://tegrak2x.blogspot.com/2011/11/lulzactive-governor-v2.html
          If in doubt, say N.	 

config CPU_FREQ_GOV_BLUACTIVE
	tristate "'bluactive' cpufreq governor"
	depends on CPU_FREQ
	help
	  'bluactive' - less aggressive version of conservative

config CPU_FREQ_GOV_INTEL
	tristate "'intel' cpufreq policy governor"
	help
	  'intel' - This driver adds a dynamic cpufreq policy governor
	  designed for Intel mobile platform.

	  This governor uses physical core load, dynamic timer switching,
	  dynamic sampling window sizing, and tailored CPU frequency scaling,
	  which brings good performance, power efficiency and responsiveness
	  to common Android applications with Intel mobile platforms.

	  To compile this driver as a module, choose M here: the
	  module will be called cpufreq_intel.

config CPU_FREQ_GOV_HOTPLUG
	tristate "'hotplug' cpufreq governor"
	select CPU_FREQ_TABLE
	help
	  'hotplug' - this driver mimics the frequency scaling behavior
	  in 'ondemand', but with several key differences.  First is
	  that frequency transitions use the CPUFreq table directly,
	  instead of incrementing in a percentage of the maximum
	  available frequency.  Second 'hotplug' will offline auxillary
	  CPUs when the system is idle, and online those CPUs once the
	  system becomes busy again.  This last feature is needed for
	  architectures which transition to low power states when only
	  the "master" CPU is online, or for thermally constrained
	  devices.

	  If you don't have one of these architectures or devices, use
	  'ondemand' instead.

	  If in doubt, say N

config CPU_FREQ_GOV_HYBRID
	tristate "'hybrid' cpufreq policy governor"
	select CPU_FREQ_TABLE
	help
	  'hybrid' - This driver adds a dynamic cpufreq policy governor.
	  The governor does a periodic polling and 
	  changes frequency based on the CPU utilization.
	  The support for this governor depends on CPU capability to
	  do fast frequency switching (i.e, very low latency frequency
	  transitions). 

	  To compile this driver as a module, choose M here: the
	  module will be called cpufreq_hybrid.

	  For details, take a look at linux/Documentation/cpu-freq.

	  If in doubt, say N.

config CPU_FREQ_GOV_SMARTASSH3
  	tristate "'smartassH3' cpufreq governor"
  	depends on CPU_FREQ
  	help
    	'smartassH3' - a "smart" governor

config CPU_FREQ_GOV_NIGHTMARE
	tristate "'nightmare' cpufreq governor"
	depends on CPU_FREQ

config CPU_FREQ_GOV_LAZY
	tristate "'lazy' cpufreq governor"
	depends on CPU_FREQ

config CPU_FREQ_GOV_PEGASUSQ
	tristate "'pegasusq' cpufreq policy governor"
```
